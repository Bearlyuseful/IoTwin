VERSION "IoTwin light demo 0.2"

NS_ :

BS_:

BU_: LightECU Visualizer WallSwitch Gateway

BO_ 256 LAMP_CMD: 1 LightECU
 SG_ LampOn : 0|1@1+ (1,0) [0|1] "" Visualizer,Gateway

BO_ 512 SWITCH_STATE: 1 WallSwitch
 SG_ SwitchOn : 0|1@1+ (1,0) [0|1] "" LightECU

CM_ BO_ 256 "Lamp relay command of the light ECU (can_sim).
Sent on every change and cyclically every 500 ms.";
CM_ BO_ 512 "Position of a wall switch: the switch in the visualizer or button B1 of the NUCLEO-G0B1RE.";
CM_ SG_ 256 LampOn "1 = relay closed, lamp on";

VAL_ 256 LampOn 0 "Off" 1 "On" ;
VAL_ 512 SwitchOn 0 "Off" 1 "On" ;
